## drivers/audio/Kconfig.es8311
```kconfig
# Copyright 2025 LYJ
# SPDX-License-Identifier: Apache-2.0

config AUDIO_CODEC_ES8311
	bool "everest ES8311 codec support"
	default y
	select I2C
	depends on DT_HAS_EVEREST_ES8311_ENABLED
	help
	  Enable support for the everest es8311 codec
```

## dts/bindings/audio/everest,es8311.yaml
```yaml
# Copyright (c) 2025 Your Company
# SPDX-License-Identifier: Apache-2.0

description: |
    Everest Semiconductor ES8311 Low Power Mono Audio CODEC.
    The ES8311 is a high-performance, low-power mono audio CODEC with 
    a multi-bit delta-sigma ADC and DAC. It supports I2S/PCM serial data 
    interfaces and is configured via I2C.

compatible: "everest,es8311"

include: [i2c-device.yaml]

properties:
  reg:
    required: true

  mclk-from-sclk:
    type: boolean
    description: |
      If set, the codec will derive its master clock from the SCLK pin
      instead of the MCLK pin.
```

## dts/bindings/i2s/espressif,esp32-i2s.yaml
```yaml
description: ESP32 I2S

compatible: "espressif,esp32-i2s"

include: [i2s-controller.yaml, pinctrl-device.yaml]

properties:
  reg:
    required: true

  pinctrl-0:
    required: true

  pinctrl-names:
    required: true

  clocks:
    required: true

  interrupts:
    required: true

  interrupt-parent:
    required: true

  unit:
    type: int
    required: true
    description: I2S unit number.
      Possible values are 0,1,.. depending on chip.

  mck-enabled:
    type: boolean
    description: |
      Master Clock Output function.
      An mck pin must be listed within pinctrl-0 when enabling this property.
```
